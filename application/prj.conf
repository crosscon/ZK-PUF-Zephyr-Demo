## CMakeLists.txt
```
# SPDX-License-Identifier: Apache-2.0

cmake_minimum_required(VERSION 3.20.0)

find_package(Zephyr REQUIRED HINTS $ENV{ZEPHYR_BASE})
project(guest_vm)

target_sources(app PRIVATE src/main.c
                           src/crosscon_hv/crosscon_hv_config.c
                           src/crosscon_hv/crosscon_hv_tee/crosscon_hv_tee.c
                           src/commands/helpers.c
                           src/commands/ta_init.c
                           src/commands/ta_commit.c
                           src/commands/ta_zk_get_proofs.c
                           src/commands/ta_zk_verify_proofs.c
                           )

include_directories(src/
                    src/crosscon_hv/
                    src/crosscon_hv/crosscon_hv_tee/
                    src/commands
                    )
```

## west.yml
```
manifest:
  remotes:
    - name: zephyrproject-rtos-fork
      url-base: https://github.com/crosscon
  projects:
    - name: zephyr
      remote: zephyrproject-rtos-fork
      revision: UC1_1_VM_BASE
      import: true
  self:
    path: application
```

## prj.conf
```kconfig
CONFIG_MAIN_STACK_SIZE=8192

CONFIG_MBEDTLS=y
CONFIG_MBEDTLS_ECP_C=y
CONFIG_MBEDTLS_ECP_DP_SECP256R1_ENABLED=y
CONFIG_MBEDTLS_ECP_NIST_OPTIM=y

CONFIG_LOG=y
CONFIG_LOG_MODE_IMMEDIATE=y
CONFIG_LOG_DEFAULT_LEVEL=3

CONFIG_SHELL=y
CONFIG_SHELL_CMDS=y
CONFIG_SHELL_TAB=y
CONFIG_SHELL_HISTORY=y
CONFIG_SHELL_PROMPT_UART="$ "
CONFIG_SHELL_CMD_BUFF_SIZE=512
CONFIG_SHELL_BACKEND_SERIAL_RX_RING_BUFFER_SIZE=512

# Uncomment for debugging
# CONFIG_LOG_DEFAULT_LEVEL=4
# CONFIG_KERNEL_LOG_LEVEL_OFF=y
```

## src/main.c
```c
#include <zephyr/logging/log.h>
LOG_MODULE_REGISTER(GUEST_VM);

#include "crosscon_hv_config.h"
#include "globals.h"

/* Global vars or context for TEE session */
const struct device *tee_dev = NULL;
volatile uint8_t *shm_ptr = NULL;

#define CLIENT_UUID_BYTES { \
    0x10, 0x20, 0x30, 0x40, \
    0x50, 0x60, \
    0x70, 0x80, \
    0x90, 0xA0, 0xB0, 0xC0, 0xD0, 0xE0, 0xF0, 0x00 \
}

#define PUF_TA_UUID_BYTES { \
    0x00, 0x11, 0x22, 0x33, \
    0x44, 0x55, \
    0x66, 0x77, \
    0x88, 0x99, 0xAA, 0xBB, 0xCC, 0xDD, 0xEE, 0xFF \
}

static const uint8_t PUF_TA_UUID[TEE_UUID_LEN] = PUF_TA_UUID_BYTES;

static const uint8_t CLIENT_UUID[TEE_UUID_LEN] = CLIENT_UUID_BYTES;

int main(void)
{
    tee_dev = device_get_binding("crosscon_hv_tee");
    if (!tee_dev) {
        LOG_ERR("Failed to bind device 'crosscon_hv_tee'");
        return -1;
    }

    ipc_shm.dev   = tee_dev;
    ipc_shm.addr  = (void *)(uintptr_t)VMS_PAYLOAD_PTR;
    ipc_shm.size  = (uint64_t)VMS_USABLE_PAYLOAD_SIZE;
    ipc_shm.flags = 0;
    shm_ptr = (volatile uint8_t *)ipc_shm.addr;

    memcpy(session_arg.uuid, PUF_TA_UUID, TEE_UUID_LEN);
    memcpy(session_arg.clnt_uuid, CLIENT_UUID, TEE_UUID_LEN);
    session_arg.clnt_login = TEE_IOCTL_LOGIN_USER;
    session_arg.cancel_id  = 0;

    int res = tee_open_session(tee_dev, &session_arg, 0, NULL, &session_id);
    if (res || session_arg.ret) {
        LOG_ERR("tee_open_session() failed: res=%d, TEE_ret=0x%08x", res, session_arg.ret);
        return -1;
    }

    printk("TEE Session opened: ID = %u\n", session_id);
    printk("Shell ready. Type `help` for available commands\n");

    return 0;
}
```

## src/bao_config.c
```c
#include "bao_config.h"
#include <stdio.h>
#include <string.h>
#include "tee_internal_api.h"
#include "flash_handler.h"
#include "puf_prover.h"
#include "mbedtls/ecp.h"
#include "mbedtls/memory_buffer_alloc.h"
#include "utils.h"
#include "config_data.h"

void (*bao_hypercall)(unsigned int, unsigned int, unsigned int) =
    (void (*)(unsigned int, unsigned int, unsigned int))BAO_HC_ADDR;

void ipc_notify(int ipc_id, int event_id)
{
    bao_hypercall(BAO_HC_IPC_ID, ipc_id, event_id);
}

typedef struct {
    uint8_t      uuid[TEE_UUID_LEN];
    TEE_Result (*handler)(void);
} uuid_func_map_t;



TEE_Result puf_enrollment_handler(void){
    
    if(!puf_and_ecc_intialisation){
        printf("PUF and Flash initialisation was not performed before enrollment\t\n");
        return TEE_ERROR_GENERIC;
    }

    puf_and_ecc_intialisation = false;

    int ret;
    
    ret = perform_enrollment(&ecp_grp,&h_point,&C_point,c1,CHALLENGE_SIZE, c2, CHALLENGE_SIZE, 
        PUF,puf_config_instance,
        activation_code_buffer,
        PUF_ACTIVATION_CODE_SIZE,
        flash_area_instance,
        flash_dev_instance,
        ENROLLMENT_IS_UP);

    if(ret!=0){
        printf("Couldn't finish the enrollment\r\n");
        return TEE_ERROR_GENERIC;
    }
    else
    {
        printf("Enrollment was a success. Below you can find the commitment\r\n");

        uint8_t commitment_buffer[COMMITMENT_BUFFER_SIZE];

        size_t olen;
        olen = export_commitment(&ecp_grp,&C_point, commitment_buffer, sizeof(commitment_buffer));
        if (olen < 0) {
        printf("Error exporting commitment, error code: %d\n", olen);
        return 1;
        }


        printf("Commitment: ");
        for (size_t i = 0; i < COMMITMENT_BUFFER_SIZE; i++) {
        printf("%02X", commitment_buffer[i]);
        }
        printf("\n");
    }

    return TEE_SUCCESS;
}

TEE_Result puf_authentication_handler(void){

    if(!puf_and_ecc_intialisation){
        printf("PUF and Flash initialisation was not performed before authentication\t\n");
        return TEE_ERROR_GENERIC;
    }

    puf_and_ecc_intialisation = false;

    int ret;

    mbedtls_ecp_point proof;
    mbedtls_ecp_point_init(&proof);
    mbedtls_mpi result_v, result_w, nonce;
    mbedtls_mpi_init(&result_v);
    mbedtls_mpi_init(&result_w);
    mbedtls_mpi_init(&nonce);

    ret = perform_authentication(&ecp_grp, &ecp_grp.G, &h_point, &proof, &C_point, &result_v, &result_w, &nonce , c1, CHALLENGE_SIZE, c2, CHALLENGE_SIZE, 
                        PUF,puf_config_instance,
                        activation_code_buffer,
                        PUF_ACTIVATION_CODE_SIZE,
                        flash_area_instance,
                        flash_dev_instance,commitment_hex, COMMITMENT_BUFFER_SIZE);

    if(ret!=0){
        printf("Couldn't Authenticate the device\r\n");
        return TEE_ERROR_GENERIC;
    }
    else
    {
        printf("Authentication was a success. Below you can find the variables to return\r\n");
        print_mpi("v", &result_v);
        print_mpi("w", &result_w);
        print_mpi("nonce", &nonce);
        print_ecp_point("proof", &ecp_grp, &proof);
    }

    return TEE_SUCCESS;
}

TEE_Result initialise_parameters(void){

    puf_and_ecc_intialisation = false;

    int ret;
    // Initialize flash area and device 
    ret = flash_initialize(FIXED_PARTITION_ID(STORAGE_PARTITION), &flash_area_instance, &flash_dev_instance);
    if (ret != 0) {
        printf("Flash Initialization failed!\r\n");
        return TEE_ERROR_GENERIC;
    }

    if(initialize_puf_and_ECC(&ecp_grp,&h_point,&C_point, PUF, puf_config_instance, activation_code_buffer, PUF_ACTIVATION_CODE_SIZE, flash_area_instance, flash_dev_instance, ENROLLMENT_IS_UP) != 0 ){
        printf("Couldn't Initialise\r\n");
        return TEE_ERROR_GENERIC;
    }
    
    puf_and_ecc_intialisation = true;

    return TEE_SUCCESS;
}


static const uuid_func_map_t function_table[] = {
    {
        .uuid = {
            0x00, 0x11, 0x22, 0x33,   /* timeLow    */
            0x44, 0x55,               /* timeMid    */
            0x66, 0x77,               /* timeHi+ver */
            0x88, 0x99, 0xAA, 0xBB,   /* clockSeq   */
            0xCC, 0xDD, 0xEE, 0xFF    /* node       */
        },
        .handler = puf_enrollment_handler,
    },
    {
        .uuid = {
            0x11, 0x22, 0x33, 0x44,   /* timeLow    */
            0x55, 0x66,               /* timeMid    */
            0x77, 0x88,               /* timeHi+ver */
            0x99, 0xAA, 0xBB, 0xCC,   /* clockSeq   */
            0xDD, 0xEE, 0xFF, 0x00    /* node       */
        },
        .handler = puf_authentication_handler,
    },
    {
        .uuid = {
            0x22, 0x33, 0x44, 0x55,   /* timeLow    */
            0x66, 0x77,               /* timeMid    */
            0x88, 0x99,               /* timeHi+ver */
            0xAA, 0xBB, 0xCC, 0xDD,   /* clockSeq   */
            0xEE, 0xFF, 0x00, 0x11    /* node       */
        },
        .handler = initialise_parameters,
    }
};

void print_hex(const char* label, const void* data, size_t len) {
    const uint8_t* bytes = (const uint8_t*)data;
    printf("%s: ", label);
    for (size_t i = 0; i < len; ++i) {
        printf("%02X", bytes[i]);
        if (i < len - 1) printf(":");
    }
    printf("\r\n");
}

void ipc_irq_handler(void)
{
    uint8_t   received_uuid[TEE_UUID_LEN];
    TEE_Result result = TEE_ERROR_GENERIC;

    /* Copy the UUID from shared memory */
    memcpy(&received_uuid, message[0], sizeof(received_uuid));
    print_hex("Received UUID", &received_uuid, sizeof(received_uuid));

    /* Iterate and compare contents of each entry */
    for (int i = 0; i < ARRAY_SIZE(function_table); i++) {
        if (memcmp(&received_uuid,
                   function_table[i].uuid,
                   sizeof(received_uuid)) == 0) {
            /* Call handler and capture the result */
            printf("UUID matched entry %d; calling handler…\n", i);
            result = function_table[i].handler();
            /* Write the return code and inform that interrupt got handled */
            memcpy(message[1], &result, sizeof(result));
            ipc_notify(0,0);
        } else {
            printf("No matching UUID in table.\n");
        }
    }
}
```

## src/bao_config.h
```c
#include <string.h>
#include <stdint.h>
#include <zephyr/irq.h>
#include <cmsis_core.h>

#define VM                  "VM1"
#define IPC_IRQ_ID          63      //79 on Bao config
#define BAO_IMAGE_START     0x10000000UL
#define BAO_HC_OFF          0x41UL
#define BAO_HC_ADDR         ((uintptr_t)BAO_IMAGE_START + BAO_HC_OFF)
#define BAO_HC_IPC_ID       0x1
#define VMS_IPC_BASE        0x20017000UL
#define VMS_IPC_SIZE        0x1000

/* Define shared memory layout */
#define MESSAGE0_SIZE       ((const size_t)(0x10)) //128-bit/16-byte - place for TEE Calls UUID
#define MESSAGE0_OFFSET     VMS_IPC_BASE

#define MESSAGE1_SIZE       ((const size_t)(0x4))  //32-bit/4-byte - place for TEEC_Result
#define MESSAGE1_OFFSET     MESSAGE0_OFFSET + MESSAGE0_SIZE

#define MESSAGE2_SIZE       ((const size_t)(VMS_IPC_SIZE - MESSAGE0_SIZE - MESSAGE1_SIZE)) //Ugly, WIP
#define MESSAGE2_OFFSET     MESSAGE1_OFFSET + MESSAGE1_SIZE

static char* const message[3] = {
    (const char*)(MESSAGE0_OFFSET),
    (const char*)(MESSAGE1_OFFSET),
    (const char*)(MESSAGE2_OFFSET),
};

extern void (*bao_hypercall)(unsigned int, unsigned int, unsigned int);

void ipc_notify(int ipc_id, int event_id);
void ipc_irq_handler(void);
```

## src/config_data.c
```c
#include "config_data.h"

const char *commitment_hex = "0485E41D73D71C62636D6D8FCE2349382FB2FBCFD618229431957B551F8F3F84B9EFC43EAF541F981F05AB97820F0DE552E77F5924311A3450F37BD0DC9AD16693"; // Update before running authentication

const uint8_t c1[CHALLENGE_SIZE] = {
    0x3C, 0xA1, 0xF4, 0x92,
    0x57, 0xB8, 0x0E, 0x6D,
    0x1F, 0xA9, 0xC3, 0xE7,
    0x74, 0x90, 0x12, 0xAD
};

const uint8_t c2[CHALLENGE_SIZE] = {
    0xFF, 0x00, 0xFF, 0x00,
    0xFF, 0x00, 0xFF, 0x00,
    0x00, 0xFF, 0x00, 0xFF,
    0x00, 0xFF, 0x00, 0xFF
};


//ECC points 
puf_config_t puf_config_instance;

mbedtls_ecp_group ecp_grp;
mbedtls_ecp_point h_point, C_point;

bool puf_and_ecc_intialisation = false;


//activation code
__attribute__((aligned(16))) uint8_t activation_code_buffer[PUF_ACTIVATION_CODE_SIZE];

//flash parameters
const struct flash_area *flash_area_instance = NULL;
const struct device *flash_dev_instance= NULL;
```

## src/config_data.h
```c
// config_data.h
#ifndef CONFIG_DATA_H
#define CONFIG_DATA_H

#include <stdint.h>
#include "mbedtls/ecp.h"
#include "puf_prover.h"


#define ENROLLMENT_IS_UP 1
#define COMMITMENT_BUFFER_SIZE 65
#define CHALLENGE_SIZE 16

// Commitment string declaration
extern const char *commitment_hex;

// Challenge arrays declaration
extern const uint8_t c1[CHALLENGE_SIZE];
extern const uint8_t c2[CHALLENGE_SIZE];


//ECC points 
extern puf_config_t puf_config_instance;

extern mbedtls_ecp_group ecp_grp;
extern mbedtls_ecp_point h_point, C_point;

extern bool puf_and_ecc_intialisation;


//activation code for puf
extern __attribute__((aligned(16))) uint8_t activation_code_buffer[PUF_ACTIVATION_CODE_SIZE];

//flash parameters
extern const struct flash_area *flash_area_instance;
extern const struct device *flash_dev_instance;

#endif // CONFIG_DATA_H
```

## src/flash_handler.h
```c
#include <zephyr/drivers/flash.h>
#include <zephyr/storage/flash_map.h>

/* Flash configuration macros, specific to
 * platform/use-case. These were based
 * on the LPC55S69 board */

#ifndef FLASH_WRITE_SIZE
#define FLASH_WRITE_SIZE  0x200 /* 512 bytes as per DTS */
#endif
#ifndef PARTITION_OFFSET
#define PARTITION_OFFSET  0     /* Offset within the partition */
#endif
#ifndef STORAGE_PARTITION
#define STORAGE_PARTITION storage_partition
#endif

/* Define flash layout offsets within the partition */
#define FLASH_OFFSET_ACTIVATION_CODE (PARTITION_OFFSET + 0)
#define FLASH_SIZE_ACTIVATION_CODE   ALIGN_UP(PUF_ACTIVATION_CODE_SIZE, FLASH_WRITE_SIZE)

#define FLASH_OFFSET_INTRINSIC_KEY_1_KC (FLASH_OFFSET_ACTIVATION_CODE + FLASH_SIZE_ACTIVATION_CODE)
#define FLASH_SIZE_INTRINSIC_KEY_1_KC   ALIGN_UP(PUF_KEY_CODE_SIZE, FLASH_WRITE_SIZE)

/* Later additional variables can be tracked as needed, for example:
 * #define FLASH_OFFSET_ADDITIONAL_VAR (FLASH_OFFSET_ACTIVATION_CODE + FLASH_SIZE_ACTIVATION_CODE)
 * #define FLASH_SIZE_ADDITIONAL_VAR   0x400
 */

/* Macro to align size up to the next multiple of 'align' */
#define ALIGN_UP(x, align) (((x) + (align) - 1) & ~((align) - 1))

/**
 * @brief Initializes the flash area and returns the flash device pointer.
 *
 * @param partition_id   Identifier for the flash partition.
 * @param flash_area_out Pointer to the flash_area pointer to be filled.
 * @param flash_dev_out  Pointer to the flash device pointer to be filled.
 *
 * @return 0 on success, -1 on error.
 */
int flash_initialize(uint32_t partition_id, const struct flash_area **flash_area_out, const struct device **flash_dev_out);

/**
 * @brief Writes data to flash with page-size alignment.
 *
 * @param flash_dev       Pointer to the flash device.
 * @param flash_area      Pointer to the flash area structure.
 * @param data_offset     Data starting point offset within the partition.
 * @param data            Pointer to the data to be written.
 * @param data_size       Size of the data.
 *
 * @return 0 on success, -1 on error.
 */
int flash_write_padded(const struct device *flash_dev, const struct flash_area *flash_area, off_t data_offset,
                       const uint8_t *data, size_t data_size);

/**
 * @brief Reads data from flash into a provided buffer.
 *
 * @param flash_dev       Pointer to the flash device.
 * @param flash_area      Pointer to the flash area structure.
 * @param data_offset     Data starting point offset within the partition.
 * @param buffer          Destination buffer for read data.
 * @param data_size       Size of the data to read.
 *
 * @return 0 on success, -1 on error.
 */
int flash_read_data(const struct device *flash_dev, const struct flash_area *flash_area, off_t data_offset,
                    uint8_t *buffer, size_t data_size);
```

## src/globals.h
```c
#include <zephyr/kernel.h>
#include <zephyr/shell/shell.h>

/* Global vars or context for TEE session */
extern const struct device *tee_dev;
extern volatile uint8_t *shm_ptr;
```

## src/puf_prover.c
```c
#include <stdio.h>
#include "puf_prover.h"
#include "flash_handler.h"
#include "mbedtls/bignum.h"
#include "mbedtls/sha256.h"
#include "mbedtls/ctr_drbg.h"
#include "mbedtls/entropy.h"
#include "mbedtls/ecp.h"
#include <stddef.h>
#include "utils.h"

// Helper Function to initialise puf and ECC together
int initialize_puf_and_ECC(mbedtls_ecp_group *grp, mbedtls_ecp_point *h, mbedtls_ecp_point *C , 
                            PUF_Type *puf, puf_config_t pufConfig,
                            uint8_t *activation_code,
                            size_t activation_code_size,
                            const struct flash_area *flash_area,
                            const struct device *flash_dev,
                            bool writeToFlash){
    
    int ret = 0;
    
    ret = initialize_and_start_puf(puf,pufConfig,
        activation_code,
        activation_code_size,
        flash_area,
        flash_dev,
        writeToFlash);

    if(ret!=0){
        printf("PUF Initialisation Failed\r\n");
        return ret;
    }

    ret = init_ECC(grp,h,C);
    if(ret!=0)
    {
        printf("ECC couldn't be initiliased\r\n");
        return ret;
    }

}


int initialize_and_start_puf(PUF_Type *puf,puf_config_t pufConfig,
                          uint8_t *activation_code,
                          size_t activation_code_size,
                          const struct flash_area *flash_area,
                          const struct device *flash_dev,
                          bool writeToFlash){
    status_t status;
    int ret;

    /* Get default configuration and initialize the provided PUF instance */
    PUF_GetDefaultConfig(&pufConfig);
    status = PUF_Init(puf, &pufConfig);
    if (status != kStatus_Success) {
        printf("Error: PUF initialization failed!\r\n");
        return -1;
    }
    printf("PUF Initialized Successfully.\r\n");

    if (writeToFlash) {
        /* Enroll and generate the activation code */
        memset(activation_code, 0, activation_code_size);
        status = PUF_Enroll(puf, activation_code, activation_code_size);
        if (status != kStatus_Success) {
            printf("Error: PUF enrollment failed!\r\n");
            flash_area_close(flash_area);
            return -1;
        }
        printf("PUF Enroll successful. Activation Code created.\r\n");

        /* Write the activation code to flash with padding */
        ret = flash_write_padded(flash_dev, flash_area, FLASH_OFFSET_ACTIVATION_CODE,
                                 activation_code, activation_code_size);
        if (ret != 0) {
            flash_area_close(flash_area);
            return -1;
        }
        printf("Activation code saved in flash.\r\n");

        /* Reinitialize PUF after enrollment */
        PUF_Deinit(puf, &pufConfig);
        PUF_Init(puf, &pufConfig);
        printf("PUF Reinitialized after enrollment.\r\n");
    } else {
        /* Read the activation code from flash */
        ret = flash_read_data(flash_dev, flash_area, FLASH_OFFSET_ACTIVATION_CODE,
                              activation_code, activation_code_size);
        if (ret != 0) {
            flash_area_close(flash_area);
            return -1;
        }
        printf("Activation code read from flash.\r\n");
    }

    /* Start the PUF with the activation code */
    status = PUF_Start(puf, activation_code, activation_code_size);
    if (status != kStatus_Success) {
        printf("Error: PUF start failed!\r\n");
        return -1;
    }
    printf("PUF Started successfully.\r\n");

    return 0;
}


int get_puf_key(PUF_Type *puf,
                          uint8_t *activation_code,
                          size_t activation_code_size,
                          const struct flash_area *flash_area,
                          const struct device *flash_dev,
                          bool writeToFlash,
                          uint8_t *outputBuffer)
{
    
    uint8_t keyCode[PUF_KEY_CODE_SIZE] = {0};
    uint8_t intrinsicKey[PUF_KEY_SIZE] = {0};
    int ret;
    
    if (writeToFlash) {

        ret = PUF_SetIntrinsicKey(PUF, kPUF_KeyIndex_01, PUF_KEY_SIZE, keyCode, sizeof(keyCode));
        if (ret != 0) {
            printf("PUF Intrinsic key 1 generation failed!\r\n");
            return ret;
        }

        ret = flash_write_padded(flash_dev, flash_area, FLASH_OFFSET_INTRINSIC_KEY_1_KC,
                                 keyCode, PUF_KEY_CODE_SIZE);
        if (ret != 0) {
            printf("PUF Intrinsic key 1 KC saving to flash failed!\r\n");
            return ret;

        }
    } else {
        ret = flash_read_data(flash_dev, flash_area, FLASH_OFFSET_INTRINSIC_KEY_1_KC ,
                              keyCode, PUF_KEY_CODE_SIZE);
        if (ret != 0) {
            flash_area_close(flash_area);
            return -1;
        }
        printf("Intrinsic key code read from flash.\r\n");
    }

    /* Reconstruct intrinsic key from keyCode1 generated by PUF_SetIntrinsicKey() */
    ret = PUF_GetKey(PUF, keyCode, sizeof(keyCode), intrinsicKey, sizeof(intrinsicKey));
    if (ret != kStatus_Success)
    {
        printf("Error reconstructing intrinsic key!\r\n");
    }

    if (outputBuffer != NULL) {
        memcpy(outputBuffer, intrinsicKey, PUF_KEY_SIZE);
    }
    
    flash_area_close(flash_area);

    return 0;
}

int get_response_to_challenge(const uint8_t *c, size_t c_size, mbedtls_mpi *r, PUF_Type *puf,
                          uint8_t *activation_code,
                          size_t activation_code_size,
                          const struct flash_area *flash_area,
                          const struct device *flash_dev,
                          bool writeToFlash
                          ){
    
    int ret;
    uint8_t keysize = PUF_KEY_SIZE;
    uint8_t *key = malloc(keysize);
    uint8_t *hashOutput = malloc(keysize);

    ret = get_puf_key(puf,activation_code,activation_code_size,
                          flash_area,flash_dev,
                          writeToFlash,
                          key);

    if(ret!=0){
        printf("Error While Getting Response From PUF");
        return ret;
    }

    uint8_t combined[c_size + keysize];

    // Combine keyCode and challenge
    memcpy(combined, key, keysize);
    memcpy(combined + keysize, c, c_size);
   
    // Hash the combined data
    mbedtls_sha256(combined, sizeof(combined), hashOutput, 0);
    

    if (mbedtls_mpi_read_binary(r, hashOutput, PUF_KEY_SIZE) != 0) {
        free(hashOutput);
        free(key);
    	return 1;
    }

    free(hashOutput);
    free(key);

    return 0;
}


int init_ECC(mbedtls_ecp_group *grp, mbedtls_ecp_point *h, mbedtls_ecp_point *C ){
    mbedtls_ecp_group_init(grp);
	mbedtls_ecp_point_init(h);
	mbedtls_ecp_point_init(C);
	int res;
	res = mbedtls_ecp_group_load(grp, MBEDTLS_ECP_DP_SECP256R1);

    if (res != 0) {
        printf("Failed to load EC group: -0x%04X\n", -res);
        return 1;
    }
    
    mbedtls_mpi x;
	mbedtls_mpi_init(&x);
	res = mbedtls_mpi_lset(&x, CONSTANT_FOR_H_GENERATOR);  
	
     if (res != 0) {
        printf("Failed to set X");
        return 1;
    }
    
    res = mbedtls_ecp_mul(grp, h, &x, &grp->G, rand_function, NULL);
    
    if (res != 0) {
        printf("Failed to generate h point: %d\n", res);
        return 1;
    }

    return 0;
}



int perform_enrollment(mbedtls_ecp_group *grp, mbedtls_ecp_point *h, mbedtls_ecp_point *C , const uint8_t *c1, size_t c1_size, const uint8_t *c2, size_t c2_size , 
                          PUF_Type *puf,puf_config_t pufConfig,
                          uint8_t *activation_code,
                          size_t activation_code_size,
                          const struct flash_area *flash_area,
                          const struct device *flash_dev,
                          bool writeToFlash){
    
    printf("Enrollement Started\r\n");

	mbedtls_mpi mpiValue_R1, mpiValue_R2;
	mbedtls_mpi_init(&mpiValue_R1);
	mbedtls_mpi_init(&mpiValue_R2);

	if (get_response_to_challenge(c1,c1_size,&mpiValue_R1,puf,activation_code,
                          activation_code_size,
                          flash_area,
                          flash_dev,
                          writeToFlash) != 0) {
		return 1;
	}

	if (get_response_to_challenge(c2,c2_size,&mpiValue_R2,puf,activation_code,  // Write to FLash always false since it is initialised in first call
                          activation_code_size,
                          flash_area,
                          flash_dev,
                          false) != 0) {
		return 1;
	}
    
	if(mbedtls_ecp_muladd(grp, C, &mpiValue_R1, &grp->G, &mpiValue_R2, h) != 0) { // C = g * R1 + h * R2
		return 1;
	}
	return 0;

}



int add_mul_mod(mbedtls_mpi *mpiValue_1, mbedtls_mpi *mpiValue_2,
		mbedtls_mpi *mpiValue_R, mbedtls_mpi *mpiValue_p, mbedtls_mpi *result) {

	if (mbedtls_mpi_mul_mpi(result, mpiValue_2, mpiValue_R) != 0) {
		return 1;
	}
	if (mbedtls_mpi_add_mpi(result, result, mpiValue_1) != 0) {
		return 1;
	}
	if (mbedtls_mpi_mod_mpi(result, result, mpiValue_p) != 0) {
		return 1;
	}
	return 0;
}

// Helper Function To Convert Commitment Hex To ECC Point
int get_commitment(const char *commitment_hex, size_t commitment_size, mbedtls_ecp_group *grp, mbedtls_ecp_point *C){
    
    uint8_t commitment[commitment_size];
        
    // Convert the hex string to binary buffer
    int ret = hex_string_to_bytes(commitment_hex, commitment, sizeof(commitment));
    if (ret != 0) {
        printf("Invalid hex string or buffer size too small\n");
        return -1;
    }

    printf("Commitment received (in hex):\n");
    for (size_t i = 0; i < sizeof(commitment); i++) {
        printf("%02x ", commitment[i]);
    }
    printf("\n");

    // Deserialize commitment into C
    ret = import_commitment(grp,commitment, C);
    if (ret != 0) {
        printf("Failed to import commitment\n");
        return ret;
    }

    return 0;

}




int perform_authentication(mbedtls_ecp_group *grp, mbedtls_ecp_point *g, mbedtls_ecp_point *h, 
                        mbedtls_ecp_point *proof, mbedtls_ecp_point *C, mbedtls_mpi *result_v, 
                        mbedtls_mpi *result_w, mbedtls_mpi *nonce,const uint8_t *c1, size_t c1_size, const uint8_t *c2, size_t c2_size , 
                          PUF_Type *puf, puf_config_t pufConfig,
                          uint8_t *activation_code,
                          size_t activation_code_size,
                          const struct flash_area *flash_area,
                          const struct device *flash_dev, const char *commitment_hex, size_t commitment_size) {


    if(get_commitment(commitment_hex, commitment_size, grp, C)!=0){
        return 1; 
    }

	unsigned char sha256_result[32];
	int res = 0;
	mbedtls_mpi mpiValue_R1, mpiValue_R2, random_r, random_u, result_c;

	mbedtls_mpi_init(&mpiValue_R1);
	mbedtls_mpi_init(&mpiValue_R2);
	mbedtls_mpi_init(&random_r);
	mbedtls_mpi_init(&random_u);
	mbedtls_mpi_init(&result_c);
    
    if (!rng_initialized) {
        if (init_random_generator() != 0) {
            printf("Random generator init failed\n");
            return 1;
        }
    }



	if (generate_random_numbers(&random_r, &random_u) != 0) {
		printf("Error in Random Process\n\n");
		return 1;
	}

	if (get_response_to_challenge(c1,c1_size,&mpiValue_R1,puf,activation_code,
                          activation_code_size,
                          flash_area,
                          flash_dev,
                          false) != 0) {
		return 1;
	}

	if (get_response_to_challenge(c2,c2_size,&mpiValue_R2,puf,activation_code,  
                          activation_code_size,
                          flash_area,
                          flash_dev,
                          false) != 0) {
		return 1;
	}

	if(mbedtls_ecp_muladd(grp, proof, &random_r, g, &random_u, h) != 0) { //proof
		return 1;
	}

    unsigned char nonce_buf[32]; // 256-bit nonce
    res = mbedtls_ctr_drbg_random(&ctr_drbg, nonce_buf, sizeof(nonce_buf));
    if (res != 0) {
        printf("Error generating nonce\n");
        return 1;
    }

    res = mbedtls_mpi_read_binary(nonce, nonce_buf, sizeof(nonce_buf));
    if (res != 0) {
        printf("Error setting nonce\n");
        return 1;
    }

	size_t olen;
	unsigned char buff[100];
	mbedtls_ecp_point_write_binary(grp, C, MBEDTLS_ECP_PF_UNCOMPRESSED, &olen, buff, sizeof(buff));
	unsigned char buff2[olen + mbedtls_mpi_size(nonce)];
	memcpy(buff2, buff, olen);
	mbedtls_mpi_write_binary(nonce, buff2 + olen, sizeof(buff2) - olen);

	sha256_hash(buff2, sizeof(buff2), sha256_result);
    mbedtls_mpi_read_string(&result_c, 16, sha256_result);

	add_mul_mod(&random_r, &result_c, &mpiValue_R1, &grp->P, result_v);
	add_mul_mod(&random_u, &result_c, &mpiValue_R2, &grp->P, result_w);
	return 0;
}
```

## src/puf_prover.h
```c
#ifndef PUF_PROVER_H
#define PUF_PROVER_H

#include "fsl_puf.h"
#include "flash_handler.h"
#include "mbedtls/ecp.h"

#define NUM_RANDOM_NUMBERS 2
#define RANDOM_NUMBER_SIZE_BYTES 32
#define PUF_SLOT 0
#define CONSTANT_FOR_H_GENERATOR 123456789

/**
 * @brief Initializes and optionally enrolls and starts the PUF module.
 *
 * @param puf               Pointer to PUF instance.
 * @param pufConfig         PUF configuration structure.
 * @param activation_code   Buffer to store or read the activation code.
 * @param activation_code_size Size of the activation code buffer.
 * @param flash_area        Pointer to flash area for storing activation code.
 * @param flash_dev         Flash device used for read/write operations.
 * @param writeToFlash      Set to true for enrollment; false to reuse stored code.
 * @return 0 on success, non zero on failure.
 */
int initialize_and_start_puf(PUF_Type *puf, puf_config_t pufConfig,
                          uint8_t *activation_code, size_t activation_code_size,
                          const struct flash_area *flash_area,
                          const struct device *flash_dev, bool writeToFlash);

/**
* @brief Retrieves the PUF key and optionally stores the key code in flash.
*
* @param puf               Pointer to PUF instance.
* @param activation_code   Pointer to activation code buffer.
* @param activation_code_size Size of activation code.
* @param flash_area        Flash area for key code storage.
* @param flash_dev         Flash device.
* @param writeToFlash      True if key code should be written to flash.
* @param outputBuffer      Output buffer for the intrinsic key (optional).
* @return 0 on success, non zero on failure.
*/
int get_puf_key(PUF_Type *puf, uint8_t *activation_code, size_t activation_code_size,
              const struct flash_area *flash_area, const struct device *flash_dev,
              bool writeToFlash, uint8_t *outputBuffer);

/**
* @brief Deinitializes the PUF instance.
*
* @param puf           Pointer to PUF instance.
* @param pufConfig     PUF configuration structure.
*/
void puf_deinit(PUF_Type *puf, puf_config_t pufConfig);

/**
* @brief Computes the response from PUF for a given challenge.
*
* @param c             Input challenge.
* @param c_size        Size of the challenge.
* @param r             Output MPI result of the hashed response.
* @param puf           PUF instance.
* @param activation_code Activation code buffer.
* @param activation_code_size Activation code size.
* @param flash_area    Flash area used for key code.
* @param flash_dev     Flash device.
* @param writeToFlash  Whether to regenerate and store key code.
* @return 0 on success, non zero on failure.
*/
int get_response_to_challenge(const uint8_t *c, size_t c_size, mbedtls_mpi *r,
                            PUF_Type *puf, uint8_t *activation_code,
                            size_t activation_code_size,
                            const struct flash_area *flash_area,
                            const struct device *flash_dev, bool writeToFlash);

/**
* @brief Initializes ECC group and point h.
*
* @param grp           ECC group to initialize.
* @param h             ECC point h to compute.
* @param C             ECC point C to initialize.
* @return 0 on success, non zero on failure.
*/
int init_ECC(mbedtls_ecp_group *grp, mbedtls_ecp_point *h, mbedtls_ecp_point *C);

/**
* @brief Performs ECC enrollment operation with two challenges and stores resulting point C.
*
* @param grp           ECC group.
* @param h             Precomputed ECC point h.
* @param C             Output ECC commitment point C.
* @param c1, c2        Challenge 1 and 2 buffers.
* @param c1_size, c2_size Size of challenge buffers.
* @param puf           PUF instance.
* @param pufConfig     PUF Config instance.
* @param activation_code Activation code.
* @param activation_code_size Size of activation code.
* @param flash_area    Flash area used.
* @param flash_dev     Flash device.
* @param writeToFlash  Whether to store new key code.
* @return 0 on success, non zero on failure.
*/
int perform_enrollment(mbedtls_ecp_group *grp, mbedtls_ecp_point *h, mbedtls_ecp_point *C,
                      const uint8_t *c1, size_t c1_size,
                      const uint8_t *c2, size_t c2_size,
                      PUF_Type *puf, puf_config_t pufConfig, uint8_t *activation_code,
                      size_t activation_code_size,
                      const struct flash_area *flash_area,
                      const struct device *flash_dev, bool writeToFlash);

/**
* @brief Adds and multiplies values modulo a given prime.
*
* @param mpiValue_1    Value to add.
* @param mpiValue_2    Value to multiply.
* @param mpiValue_R    Second value to multiply.
* @param mpiValue_p    Modulo value (usually EC group prime).
* @param result        Output result.
* @return 0 on success, non zero on error.
*/
int add_mul_mod(mbedtls_mpi *mpiValue_1, mbedtls_mpi *mpiValue_2,
                mbedtls_mpi *mpiValue_R, mbedtls_mpi *mpiValue_p,
                mbedtls_mpi *result);



/**
* @brief Performs PUF-based ECC authentication and response proof generation.
*
* @param grp           ECC group.
* @param g             Generator point g.
* @param h             Secondary generator point h.
* @param proof         Output ECC proof point.
* @param C             Commitment point.
* @param result_v      Output response scalar v.
* @param result_w      Output response scalar w.
* @param nonce         Output nonce used in hashing.
* @param c1, c2        Challenges used for authentication.
* @param c1_size, c2_size Sizes of challenges.
* @param puf           PUF instance.
* @param pufConfig     PUF Config instance.
* @param activation_code Activation code buffer.
* @param activation_code_size Size of activation code.
* @param flash_area    Flash area used for flash reads.
* @param flash_dev     Flash device used.
* @param commitment_hex Pointer of Char to store the Commitment
* @param commitment_size Size of Commitment
* @return 0 on success, non zero on failure.
*/
int perform_authentication(mbedtls_ecp_group *grp, mbedtls_ecp_point *g, mbedtls_ecp_point *h,
                          mbedtls_ecp_point *proof, mbedtls_ecp_point *C,
                          mbedtls_mpi *result_v, mbedtls_mpi *result_w,
                          mbedtls_mpi *nonce,
                          const uint8_t *c1, size_t c1_size,
                          const uint8_t *c2, size_t c2_size,
                          PUF_Type *puf, puf_config_t pufConfig, uint8_t *activation_code,
                          size_t activation_code_size,
                          const struct flash_area *flash_area,
                          const struct device *flash_dev, const char *commitment_hex, size_t commitment_size);


#endif /* PUF_PROVER_H */
```

## src/utils.c
```c
#include <stdio.h>
#include "mbedtls/ctr_drbg.h"
#include "mbedtls/entropy.h"
#include "mbedtls/ecp.h"
#include "utils.h"

void sha256_hash(const unsigned char *data, size_t data_len,
    unsigned char *output) {
    mbedtls_sha256(data, data_len, output, 0);
}

int rand_function(void *rng_state, unsigned char *output, size_t len) {

    size_t use_len;
	int rnd;

	if (rng_state != NULL)
		rng_state = NULL;

	while (len > 0) {
		use_len = len;
		if (use_len > sizeof(int))
			use_len = sizeof(int);

		rnd = rand();
		memcpy(output, &rnd, use_len);
		output += use_len;
		len -= use_len;
	}


	return (0);
}


size_t export_commitment(mbedtls_ecp_group *grp,const mbedtls_ecp_point *C, uint8_t *buf, size_t buf_size) {

    size_t olen;
	int ret = mbedtls_ecp_point_write_binary(grp, C, MBEDTLS_ECP_PF_UNCOMPRESSED, &olen, buf, buf_size);

    return (ret == 0) ? olen : -1;
}

int import_commitment(mbedtls_ecp_group *grp,const uint8_t *buf, mbedtls_ecp_point *P) {
    int ret = mbedtls_ecp_point_read_binary(grp, P, buf, 65); // 65 bytes for uncompressed point
    return ret;
}

int generate_random_numbers(mbedtls_mpi *num, mbedtls_mpi *num2) {
    if (!rng_initialized) {
        if (init_random_generator() != 0) {
            return 1;
        }
    }

    unsigned char randomBytes[64]; // 2x 32 bytes

    if (mbedtls_ctr_drbg_random(&ctr_drbg, randomBytes, sizeof(randomBytes)) != 0) {
        return 1;
    }

    if (mbedtls_mpi_read_binary(num, randomBytes, 32) != 0) {
        return 1;
    }
    if (mbedtls_mpi_read_binary(num2, randomBytes + 32, 32) != 0) {
        return 1;
    }

    return 0;
}

void print_mpi(const char *label, const mbedtls_mpi *value) {
    char buf[100];
    size_t olen;
    if (mbedtls_mpi_write_string(value, 16, buf, sizeof(buf), &olen) == 0) {
        printf("%s = %s\n", label, buf);
    } else {
        printf("Failed to print %s\n", label);
    }
}


void print_ecp_point(const char *label, const mbedtls_ecp_group *grp, const mbedtls_ecp_point *point) {

    unsigned char buf[100];
    size_t olen;

    if (mbedtls_ecp_point_write_binary(grp, point,
            MBEDTLS_ECP_PF_UNCOMPRESSED, &olen, buf, sizeof(buf)) == 0)
    {
        printf("%s = ", label);
        for (size_t i = 0; i < olen; i++) {
            printf("%02X", buf[i]);
        }
        printf("\n");
    } else {
        printf("Failed to print %s (EC point)\n", label);
    }
}

int init_random_generator() {
    const char *pers = "nonce_gen";
    mbedtls_entropy_init(&entropy);
    mbedtls_ctr_drbg_init(&ctr_drbg);

    if (mbedtls_ctr_drbg_seed(&ctr_drbg, mbedtls_entropy_func, &entropy,
                               (const unsigned char *)pers, strlen(pers)) != 0) {
        printf("Failed to seed random generator\n");
        return -1;
    }
    rng_initialized = 1;
    return 0;
}

int hex_string_to_bytes(const char *hex, uint8_t *out, size_t out_size) {
    size_t len = strlen(hex);
    if (len % 2 != 0 || len / 2 > out_size) {
        return -1; // Invalid length or buffer size too small
    }

    for (size_t i = 0; i < len / 2; i++) {
        sscanf(hex + 2 * i, "%2hhx", &out[i]); // Read two characters as one byte
    }
    return 0; // Success
}
```

## src/utils.h
```c
#ifndef UTILS_H
#define UTILS_H

#include <stdint.h>
#include <stddef.h>
#include "mbedtls/ecp.h"
#include "mbedtls/sha256.h"
#include "mbedtls/ctr_drbg.h"
#include "mbedtls/entropy.h"

#ifdef __cplusplus
extern "C" {
#endif

static mbedtls_entropy_context entropy;
static mbedtls_ctr_drbg_context ctr_drbg;
static int rng_initialized = 0;

/**
 * @brief Computes SHA-256 hash of input data.
 *
 * @param data       Pointer to input data.
 * @param data_len   Length of input data.
 * @param output     Output buffer (32 bytes) for SHA-256 hash.
 */
void sha256_hash(const unsigned char *data, size_t data_len, unsigned char *output);

/**
 * @brief Simple fallback random number generator using rand().
 *
 * @param rng_state  Unused parameter (can be NULL).
 * @param output     Buffer to store generated random bytes.
 * @param len        Number of random bytes to generate.
 * @return 0 on success.
 */
int rand_function(void *rng_state, unsigned char *output, size_t len);

/**
 * @brief Serializes an EC point to a buffer.
 *
 * @param grp        EC group the point belongs to.
 * @param C          EC point to serialize.
 * @param buf        Buffer to write the serialized point.
 * @param buf_size   Size of the buffer.
 * @return Number of bytes written on success, -1 on failure.
 */
size_t export_commitment(mbedtls_ecp_group *grp, const mbedtls_ecp_point *C, uint8_t *buf, size_t buf_size);

/**
 * @brief Deserializes an EC point from a buffer.
 *
 * @param grp        EC group to read the point into.
 * @param buf        Buffer containing the serialized EC point (65 bytes expected).
 * @param P          Destination EC point.
 * @return length on success, -1 on failure.
 */
int import_commitment(mbedtls_ecp_group *grp, const uint8_t *buf, mbedtls_ecp_point *P);

/**
 * @brief Generates two random 256-bit (32-byte) numbers using CTR_DRBG.
 *
 * @param num        Output MPI for the first random number.
 * @param num2       Output MPI for the second random number.
 * @return 0 on success, 1 on error.
 */
int generate_random_numbers(mbedtls_mpi *num, mbedtls_mpi *num2);

/**
 * @brief Prints a big number (MPI) in hexadecimal.
 *
 * @param label      Label to print before the number.
 * @param value      MPI value to print.
 */
void print_mpi(const char *label, const mbedtls_mpi *value);

/**
 * @brief Prints an EC point in uncompressed hexadecimal form.
 *
 * @param label      Label to print before the point.
 * @param grp        EC group the point belongs to.
 * @param point      EC point to print.
 */
void print_ecp_point(const char *label, const mbedtls_ecp_group *grp, const mbedtls_ecp_point *point);

/**
 * @brief Initializes the global CTR_DRBG context for secure random number generation.
 *
 * This must be called once at startup before using generateRandomNumbers().
 *
 * @return 0 on success, non-zero on error.
 */
int init_random_generator(void);

/**
 * @brief Converts a hexadecimal string to a byte array.
 *
 * @param hex       Null-terminated string containing hexadecimal characters.
 * @param out       Output buffer where the bytes will be stored.
 * @param out_size  Size of the output buffer.
 * @return int      0 on success, non zero on failure
 */
int hex_string_to_bytes(const char *hex, uint8_t *out, size_t out_size);

#ifdef __cplusplus
}
#endif

#endif // UTILS_H
```
